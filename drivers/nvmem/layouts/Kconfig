## drivers/nvmem/layouts/Kconfig
```kconfig
# SPDX-License-Identifier: GPL-2.0

config NVMEM_LAYOUTS
	bool
	depends on OF

if NVMEM_LAYOUTS

menu "Layout Types"

config NVMEM_LAYOUT_SL28_VPD
	tristate "Kontron sl28 VPD layout support"
	select CRC8
	help
	  Say Y here if you want to support the VPD layout of the Kontron
	  SMARC-sAL28 boards.

	  If unsure, say N.

config NVMEM_LAYOUT_ONIE_TLV
	tristate "ONIE tlv support"
	select CRC32
	help
	  Say Y here if you want to support the Open Compute Project ONIE
	  Type-Length-Value standard table.

	  If unsure, say N.

config NVMEM_LAYOUT_U_BOOT_ENV
	tristate "U-Boot environment variables layout"
	select CRC32
	select GENERIC_NET_UTILS
	help
	  U-Boot stores its setup as environment variables. This driver adds
	  support for verifying & exporting such data. It also exposes variables
	  as NVMEM cells so they can be referenced by other drivers.

	  If unsure, say N.

config NVMEM_LAYOUT_DLINK_ODM_TLV
	tristate "D-Link ODM partition TLV layout"
	select CRC32
	help
	  Say Y here if you want to support the D-Link ODM TLV layout.
	  It is used by the D-Link Aquila series.
	  Currently the following devices use it: E30, M30, M60, M32, R32.

	  If unsure, say N.

config NVMEM_LAYOUT_DLINK_ODM_TLV_KUNIT_TEST
	tristate "KUnit tests for the D-Link ODM partition TLV layout."
	depends on KUNIT && NVMEM_LAYOUT_DLINK_ODM_TLV
	default KUNIT_ALL_TESTS
	help
	  Say Y here to enable KUnit testing the D-Link ODM partition TLV layout.

endmenu

endif
```
